//libararies
#include <SPI.h>
#include <Wire.h>
#include <Adafruit_GFX.h>
#include <Adafruit_SH1106.h>
//#include <MFRC522.h>
#include <RFID.h>
#include <Keypad.h>
#include <Servo.h>
/*******************/
//defines
#define SS_PIN 10 //RFID
#define RST_PIN 9 //RFID
#define pir A5 //PIR
#define servo A0 //SERVO
#define sucLed A3 //GREEN LED
#define failLed A1  //RED LED
#define buzzer A2 //BUZZER
#define OLED_RESET 4 //OLED
#define NUMFLAKES 10 //OLED
#define XPOS 0 //OLED
#define YPOS 1 //OLED
#define DELTAY 2 //OLED

#define successNote 440 // success note frequency
#define failNote  220 // fail note frequency
// #define lockBtn  2
//KEYPAD
const int ROW_NUM = 4;
const int COLUMN_NUM = 4;
char keys[ROW_NUM][COLUMN_NUM] = {
 {'1','2','3', 'A'},
 {'4','5','6', 'B'},
 {'7','8','9', 'C'},
 {'*','0','#', 'D'}
};
byte pin_rows[ROW_NUM] = {8, 7, 6, 5};
byte pin_column[COLUMN_NUM] = {4, 3, 2}; 

char pin[4];
char initial_password[4] = {'1', '2', '3', '4'}; 
int i = 0;
String msg = "";
bool state = 0;  


/*******************/
// lock animation
int tt=0;
int xx=40;
int yy=0;
// the frames of the lock
const unsigned char PROGMEM lockAnimation0 [] = {0x00, 0x00, 0x00, 0x00, 0x00, 0x00, 0x00, 0x00, 0x00, 0x00, 0x00, 0x00, 0x00,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 0x00, 0x00};

const unsigned char PROGMEM lockAnimation1 [] = {0x00, 0x00, 0x00, 0x00, 0x00, 0x00, 0x00, 0x00, 0x00, 0x00, 0x00, 0x00, 0x00,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 0x00, 0x00};

const unsigned char PROGMEM lockAnimation2 [] = {0x00, 0x00, 0x00, 0x00, 0x00, 0x00, 0x00, 0x00, 0x00, 0x00, 0x00, 0x00, 0x00,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 0x00, 0x00};

const unsigned char PROGMEM lockAnimation3 [] = {0x00, 0x00, 0x00, 0x00, 0x00, 0x00, 0x00, 0x00, 0x00, 0x00, 0x00, 0x00, 0x00,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 0x00, 0x00};

const unsigned char PROGMEM lockAnimation4 [] = {0x00, 0x00, 0x00, 0x00, 0x00, 0x00, 0x00, 0x00, 0x00, 0x00, 0x00, 0x00, 0x00,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 0x00, 0x00};

const unsigned char PROGMEM lockAnimation5 [] = {0x00, 0x00, 0x00, 0x00, 0x00, 0x00, 0x00, 0x00, 0x00, 0x00, 0x00, 0x00, 0x00,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 0x00, 0x00};

const unsigned char PROGMEM lockAnimation6 [] = {0x00, 0x00, 0x00, 0x00, 0x00, 0x00, 0x00, 0x00, 0x00, 0x00, 0x00, 0x00, 0x00,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 0x00, 0x00};

const unsigned char PROGMEM lockAnimation7 [] = {0x00, 0x00, 0x00, 0x00, 0x00, 0x00, 0x00, 0x00, 0x00, 0x00, 0x00, 0x00, 0x00,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 0x00, 0x00};

const unsigned char PROGMEM lockAnimation8 [] = {0x00, 0x00, 0x00, 0x00, 0x00, 0x00, 0x00, 0x00, 0x00, 0x00, 0x00, 0x00, 0x00,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 0x00, 0x00};

const unsigned char PROGMEM lockAnimation9 [] = {0x00, 0x00, 0x00, 0x00, 0x00, 0x00, 0x00, 0x00, 0x00, 0x00, 0x00, 0x00, 0x00,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 0x00, 0x00};

const unsigned char PROGMEM lockAnimation10 [] = {0x00, 0x00, 0x00, 0x00, 0x00, 0x00, 0x00, 0x00, 0x00, 0x00, 0x00, 0x00, 0x00,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 0x00, 0x00};

const unsigned char PROGMEM lockAnimation11 [] = {0x00, 0x00, 0x00, 0x00, 0x00, 0x00, 0x00, 0x00, 0x00, 0x00, 0x00, 0x00, 0x00,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 0x00, 0x00};

const unsigned char PROGMEM lockAnimation12 [] = {0x00, 0x00, 0x00, 0x00, 0x00, 0x00, 0x00, 0x00, 0x00, 0x00, 0x00, 0x00, 0x00,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 0x00, 0x00};


/*******************/
//instances
Keypad keypad = Keypad( makeKeymap(keys), pin_rows, pin_column, ROW_NUM, COLUMN_NUM );//KEYPAD
Adafruit_SH1106 display(OLED_RESET); //OLED
Servo doorServo; //SERVO
RFID rf(SS_PIN,RST_PIN);
/*******************/
//conditions
#if (SH1106_LCDHEIGHT != 64)
#error("Height incorrect, please fix Adafruit_SH1106.h!");
#endif
/*******************/
//prototypes
void displayMessage(int);
void openDoor();
void displayunLock();
void lock();
/*******************/
void setup() {

  //begin
  Serial.begin(9600); //SERIAL
  SPI.begin(); //SPI
  display.begin(SH1106_SWITCHCAPVCC, 0x3C);  //OLED
  doorServo.attach(servo);  //Declare pin A0 for servo
  rf.init();
  //pinModes
  pinMode(pir, INPUT_PULLUP);
  pinMode(buzzer, OUTPUT);
  pinMode(failLed, OUTPUT);
  pinMode(sucLed, OUTPUT);
  //pinMode(lockBtn, INPUT_PULLUP);

  //defaults
  doorServo.write(0);
  display.setTextSize(1);
  display.setTextColor(WHITE);

  //start
  display.clearDisplay();
  display.setCursor(38,20);
  display.println("WELCOME!");
  display.display();
  delay(2000);
  bool PIRvalue = digitalRead(pir);   
  if (PIRvalue == HIGH)   {     
    displayMessage(4);
  }

}
/*******************/
void loop() {
  
  //attachInterrupt(digitalPinToInterrupt(2),lock,FALLING);  
  //check if some one stand infron of the door to change the state to true
  if(digitalRead(pir) == HIGH){
    state = 1;
  }
  else{
    state = 0;
  }
  //checks if the state is true to start the system
  if (state)   
  {            
   char key = keypad.getKey();
   // check if a key is pressed 
   if(key){
     tone(buzzer,2500,250);// the buzzer peeps to inform the user that a key is pressed
     display.print("*"); // display an astrik that represents the pin code for security purpuses
     display.display();
     pin[i] = key; // add the prees key to the pin code array
     i++; // increments the pin code counter to insert in the next field of the pin code array
     if(key == '*'){ //checks if the astrik key is presses to reset the pin code
       i = 0;
       displayMessage(4);
     }
   }
   if(rf.isCard()){ // checks if the user puts a card on the sensor
     if(rf.readCardSerial()){ // checks if the put card is UID card
       Serial.print(rf.serNum[0]);
       Serial.print(" , ");
       Serial.print(rf.serNum[1]);
       Serial.print(" , ");
       Serial.print(rf.serNum[2]);
       Serial.print(" , ");
       Serial.print(rf.serNum[3]);
       Serial.print(" , ");
       Serial.println(rf.serNum[4]);
       // prinst the 5 serial parts of the UID card
       Serial.println("-------------");
       if(rf.serNum[0] == 99 && rf.serNum[1] == 96 && rf.serNum[2] == 225 && rf.serNum[3] == 17  && rf.serNum[4] == 243){// checks every serial part of the UID card if it mathes the authroized one
         openDoor();//unlocks the door if the condition is true
       }else{// if the card is not the authorized one 
         displayMessage(0);// prints "INVALID" on the OLED
         tone(buzzer,failNote,500); // the buzzer peeps to inform the user that the used card is not the authorized one
         digitalWrite(failLed, HIGH); // the red led lights up to inform the user that the used card is not the authorized one
         delay(500);
         digitalWrite(failLed, LOW); // delays half a second then turns of the red led
         displayMessage(4);  // prints "Please enter your PINor use your card : " on the oled
       }

     }
     delay(500);
   }
  //checks if the 4-digits of the pin code are entered
   if(i == 4){
     if(!(strncmp(pin, initial_password, 4))){//checks if the the entered 4-digits matches the pin
         openDoor();//calls the open door function if the pin matches
     }else{
       displayMessage(0); //displays "INVALID" if the pin did not match
       tone(buzzer,failNote,500); // the buzzer peeps to inform the user for invalid passord
       digitalWrite(failLed, HIGH); // the red led lights up
       delay(500);
       digitalWrite(failLed, LOW);// delay for half a second then the red led is turned off
       displayMessage(4); //delay half second then prints "Please enter your PINor use your card : " on the oled
       i = 0; // resets the pin code
     }
   }
  }
}
/*******************/
//functions
void displayMessage(int c){
  // cleas what is writen on the OLED
  display.clearDisplay();
  //sets the cursor to the middle of the OLED
  display.setCursor(32,20);
  //a switch statemt to check what statemnt to print
  switch (c) {
    case 0:
      display.println("INVALID!");
      break;
    case 1:
      display.println("UNLOCKED!"); 
      break;
    case 3:
      display.println("LOCKING!");
      break;  
    case 4:
      display.setCursor(0,0);
      display.println("Please enter your PINor use your card : ");
      break;
  }
  display.display();
}

// a function to unlock the door
void openDoor(){
  // the buzzer peeps to inform the user that the door is unlocked
  tone(buzzer, successNote,500);
  // print on on the screen "UNLOCKED" to inform the user that the door will lock
  displayMessage(1);
  delay(250);
  // display the unlock animation
  displayunLock();
  //turn the servo 100 degrees to unlock the door
  doorServo.write(100);
  //turns on the green led to inform the user that the door is unlocked
  digitalWrite(sucLed, HIGH);
  //resets the pincode
  i = 0;
  delay(10000);
  //delays for 10 seconds then re lock the door
  lock();
}
//lock function
void lock(){
  // for loop that peeps the buzzer 4-times to inform the user that the door will lock
  for(int i = 0; i <= 3; i++){
    tone(buzzer,2400);
    delay(150);
    noTone(buzzer);
    delay(150);
  }
  // print on on the screen "LOCKING" to inform the user that the door will lock
  displayMessage(3);
  delay(250);
  // the buzzer peeps to inform the user that the door is locked
  tone(buzzer, 2400,500);
  // start the lock animation
  displayLock();
  //turn the servo to the 0 degree to lock the door
  doorServo.write(0);
  // turn off the green led
  digitalWrite(sucLed, LOW);
  delay(500);
  //delay half a second then prints "Please enter your PINor use your card : " on the oled
  displayMessage(4);
}
//Animation code to display the unlock animation
void displayunLock(){
  display.clearDisplay();
  display.drawBitmap(xx, yy,lockAnimation0,48,48, 1);
  display.display();
  delay(tt);

  display.clearDisplay();
  display.drawBitmap(xx, yy,lockAnimation1,48,48, 1);
  display.display();
  delay(tt);

  display.clearDisplay();
  display.drawBitmap(xx, yy,lockAnimation2,48,48, 1);
  display.display();
  delay(tt);

  display.clearDisplay();
  display.drawBitmap(xx, yy,lockAnimation3,48,48, 1);
  display.display();
  delay(tt);

  display.clearDisplay();
  display.drawBitmap(xx, yy,lockAnimation4,48,48, 1);
  display.display();
  delay(tt);

  display.clearDisplay();
  display.drawBitmap(xx, yy,lockAnimation5,48,48, 1);
  display.display();
  delay(tt);

  display.clearDisplay();
  display.drawBitmap(xx, yy,lockAnimation6,48,48, 1);
  display.display();
  delay(tt);

  display.clearDisplay();
  display.drawBitmap(xx, yy,lockAnimation7,48,48, 1);
  display.display();
  delay(tt);

  display.clearDisplay();
  display.drawBitmap(xx, yy,lockAnimation8,48,48, 1);
  display.display();
  delay(tt);

  display.clearDisplay();
  display.drawBitmap(xx, yy,lockAnimation9,48,48, 1);
  display.display();
  delay(tt);

  display.clearDisplay();
  display.drawBitmap(xx, yy,lockAnimation10,48,48, 1);
  display.display();
  delay(tt);

  display.clearDisplay();
  display.drawBitmap(xx, yy,lockAnimation11,48,48, 1);
  display.display();
  delay(tt);

  display.clearDisplay();
  display.drawBitmap(xx, yy,lockAnimation12,48,48, 1);
  display.display();
  delay(tt);
}
//Animation code to display the lock animation 
void displayLock(){
  display.clearDisplay();
  display.drawBitmap(xx, yy,lockAnimation11,48,48, 1);
  display.display();
  delay(tt);

  display.clearDisplay();
  display.drawBitmap(xx, yy,lockAnimation10,48,48, 1);
  display.display();
  delay(tt);

  display.clearDisplay();
  display.drawBitmap(xx, yy,lockAnimation9,48,48, 1);
  display.display();
  delay(tt);

  display.clearDisplay();
  display.drawBitmap(xx, yy,lockAnimation8,48,48, 1);
  display.display();
  delay(tt);

  display.clearDisplay();
  display.drawBitmap(xx, yy,lockAnimation7,48,48, 1);
  display.display();
  delay(tt);

  display.clearDisplay();
  display.drawBitmap(xx, yy,lockAnimation6,48,48, 1);
  display.display();
  delay(tt);


  display.clearDisplay();
  display.drawBitmap(xx, yy,lockAnimation5,48,48, 1);
  display.display();
  delay(tt);


  display.clearDisplay();
  display.drawBitmap(xx, yy,lockAnimation4,48,48, 1);
  display.display();
  delay(tt);

  display.clearDisplay();
  display.drawBitmap(xx, yy,lockAnimation3,48,48, 1);
  display.display();
  delay(tt);

  display.clearDisplay();
  display.drawBitmap(xx, yy,lockAnimation2,48,48, 1);
  display.display();
  delay(tt);

  display.clearDisplay();
  display.drawBitmap(xx, yy,lockAnimation1,48,48, 1);
  display.display();
  delay(tt);

  display.clearDisplay();
  display.drawBitmap(xx, yy,lockAnimation0,48,48, 1);
  display.display();
  delay(tt);
}